## hw/hexagon/Kconfig
```kconfig
config HEX_DSP
    bool
    default y
    depends on HEXAGON && TCG
    imply PTIMER
    select L2VIC  # Vector PIC
    select QTIMER
    select ARM_COMPATIBLE_SEMIHOSTING

config HEX_VIRT
    bool
    default y
    depends on HEX_DSP && FDT
    select DEVICE_TREE
    select VIRTIO_PCI
    select PL011
    select VIRTIO_BLK
    select VIRTIO_SCSI
    select VIRTIO_NET
    select VIRTIO_SERIAL
    select VIRTIO_BALLOON
    select VIRTIO_RNG
    select VIRTIO_9P
    select VIRTIO_GPU
    select PCI
    select PCI_EXPRESS
    select MSI_NONBROKEN
```

## rust/hw/char/Kconfig
```kconfig
config X_PL011_RUST
    bool

config X_QUP_GENI_UART_RUST
    bool
    select QUP_WRAPPER
```
